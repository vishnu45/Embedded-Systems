#INCLUDE <P16F877A.INC>
LIST P=16F877A
ORG 0X00
GOTO START
ORG 0X20
;OHM GAM GANAPATAYE NAMAH
;**************************************************************************************
START:
BSF STATUS,RP0
MOVLW 0XF0
MOVWF TRISB
CLRF TRISA
CLRF TRISD
BCF OPTION_REG,7  	;PORTB PULLUPS ENABLED
MOVLW 0X06
MOVWF ADCON1
BCF STATUS,RP0
MOVLW 0X00
MOVWF PORTA
MOVWF PORTD

;**************************************************************************************

GET_IT
		;OLD_KEY=0X40
		;NEW_KEY=0X41
		;COUNT=0X42
		;DATA_COUNT=0X50
MOVLW 0X00        
MOVWF 0X40      ;OLD_KEY=0
MOVWF 0X41      ;NEW_KEY=0

;**************************************************************************************

GET_IT_SUBLOOP
MOVLW 0X00

;**************************************************************************************

GET_IT_SUBLOOP2
CALL SCAN_IT
MOVF 0X22,0
MOVWF 0X41      ;MOVING KEY_VALUE TO NEW_KEY
SUBWF 0X40,0     ;W<--OLD_KEY-NEW_KEY
BTFSS STATUS,2
GOTO ASSIGN_NEW_TO_OLD
CALL DELAY
BTFSS STATUS,2
GOTO GET_IT_SUBLOOP2
GOTO AFTER_SCAN_IT

;**************************************************************************************

ASSIGN_NEW_TO_OLD
MOVF 0X41,0
MOVWF 0X40
GOTO GET_IT_SUBLOOP

;**************************************************************************************

;STARTING OF SCAN_IT
SCAN_IT
MOVLW 0X01 
MOVWF 0X20       ;0X20 IS THE KEY_COUNT VARIABLE
MOVLW 0XF7
MOVWF 0X21       ;0X21 IS THE PATTERN TO BE GIVEN TO PORTB
    SUB_LOOP
	MOVF 0X21,0
	MOVWF PORTB  ;OUTPUT 'PATTERN' TO PORTB
	MOVF 0X20,0 ;W=KEY_COUNT
	BTFSS PORTB,7
	GOTO SCAN_IT_FINISH
    ADDLW 0X03
	BTFSS PORTB,6
    	GOTO SCAN_IT_FINISH
    ADDLW 0X03
	BTFSS PORTB,5
	GOTO SCAN_IT_FINISH
    ADDLW 0X03
	BTFSS PORTB,4
	GOTO SCAN_IT_FINISH
    MOVLW 0XFF          ;THESE STEPS
    MOVWF 0X30     
    INCF 0X30,1         ;USED TO SET CARRY FOR THE RIGHT SHIFT
    MOVLW 0XFF          ;MOVING A MARKER TO W TO SHOW NO KEY PRESSED ON THE COLUMN
	INCF 0X20,1         ;INCREMENT KEY_COUNT
    RRF 0X21,1          ;SHIFT PATTERN RIGHT
    BTFSC 0X21,0        ;CHECKING IF PATTERN(0) IS CLEAR
    GOTO SUB_LOOP       ;CHECK NXT COLUMN IF PATTERN(0) IS STILL 1
SCAN_IT_FINISH
MOVWF 0X22   ;0X22 WILL HAVE THE KEYVALUE,FF-->NO READ ; 
RETURN
;FINISHING OF SCAN_IT

;***************************************************************************************

AFTER_SCAN_IT
MOVF 0X40,0 ;W<--OLD_KEY
MOVWF 0X30
INCF 0X30,1 ;CHECKING IF THE CONTINUOUSLY OCCURED VALUE WAS FF(IE. NO READ)
BTFSC STATUS,2
GOTO GET_IT
CALL OUTPUT_SETTER
GOTO GET_IT

;***************************************************************************************

DELAY:
MOVLW 0X09
MOVWF 0X61
D2
MOVLW 0X21
MOVWF 0X60
D1
DECFSZ 0X60,1
GOTO D1
DECFSZ 0X61,1
GOTO D2
RETURN

;***************************************************************************************

OUTPUT_SETTER

MOVF 0X40,0
MOVWF PORTD
MOVWF TXREG

BSF STATUS,RP0
MOVLW 0X40
MOVWF SPBRG
MOVLW 0X24
MOVWF TXSTA
BCF STATUS,RP0
BSF RCSTA,SPEN
MOVLW 0X90
MOVWF RCSTA


MOVF RCREG,0
MOVWF PORTA

RETURN




END

;************************************************************************************************

;CALL_IT AND SCAN_IT ARE AS USUAL...
;THERE'S A DATA COUNT VARIABLE 0X50 WHICH COUNTS 1,2,3,4,1,2,3,4..
;WHENEVER VALID DATA(IE. DATA NOT EQUAL TO FF IS RECEIVED)
;COUNT=1---> FOR THE FIRST TIME
;OUTPUT SETTER WILL PUT THE DATA TO LOWER NIBBLE OF PORTC
;SINCE COUNT=1 FOR THE FIRST TIME, THE HIGHER NIBBLE WILL REMAIN 
;AS 0(ALREADY CONFIGURED IN THE BEGINNING OF PROGRAM
;NOW PORTA3 BIT IS SET
;THIS IS BECAUSE I AM USING THAT TO ENABLE SSD1
;SO DATA FROM LOWER NIBBLE OF PORTC TOGETHER WITH PORTA3 CAN
;CONTROL SSD-1 THROUGH 7447 IC-1

;COUNT=2--->FOR THE FIRST TIME
;NIBBLES OF PORTC ARE SWAPPED, IE. 0 WILL BECOME THE LOWER NIBBLE NOW
;NOW SIMPLY ADD ,NEWLY GOT DATA VALUE
;SWAP AGAIN
;PORTA2 BIT IS SET
;SO HIGHER NIBBLE OF PORTC AND PORTA2 CAN CTRL SSD-2
;THROUGH 7447 IC-2

;SIMILARLY FOR COUNT-3,4 FOR THE FIRST TIME
;IN COUNT-4, THE COUNT IS CLEARED IN THE OUTPUT_SETTER
;FOR MAKING THE DISPLAY FOLLOW A CYCLIC PATTERN
;AFTER COUNTE-4,COUNT-1 WILL APPEAR FOR THE SECOND TIME FOR THE NEXT
;VALID DATA
;NOW THE NIBBLES ARE ALREADY LOADED
;SO THE LOWER NIBBLE IS CAREFULLY CLEARED AND THE NEW DATA IS INSERTED
;AND SO ON.......













    
    
      
    
    
	
	
	




#INCLUDE <P16F877A.INC>
LIST P=16F877A
ORG 0X00
GOTO START
ORG 0X20
;OHM GAM GANAPATAYE NAMAH

START:
;-------------------------------------------------------------
; INTIALISATIONS
;-------------------------------------------------------------
MOVLW 0X90
MOVWF RCSTA
BSF STATUS,RP0
CLRF TRISD
MOVLW 0X06
MOVWF SPBRG
MOVLW 0X20
MOVWF TXSTA
BCF STATUS,RP0
;-------------------------------------------------------------
; TRANSMITTING DATA
;-------------------------------------------------------------
MOVLW 0X01
MOVWF TXREG
MOVWF PORTD
CALL DELAY

MOVLW 0X02
MOVWF TXREG
MOVWF PORTD
CALL DELAY

MOVLW 0X03
MOVWF TXREG
MOVWF PORTD
CALL DELAY

MOVLW 0X04
MOVWF TXREG
MOVWF PORTD
CALL DELAY

MOVLW 0X05
MOVWF TXREG
MOVWF PORTD
CALL DELAY

MOVLW 0X06
MOVWF TXREG
MOVWF PORTD
CALL DELAY

MOVLW 0X07
MOVWF TXREG
MOVWF PORTD
CALL DELAY

MOVLW 0X08
MOVWF TXREG
MOVWF PORTD
CALL DELAY

MOVLW 0X09
MOVWF TXREG
MOVWF PORTD
CALL DELAY

MOVLW 0X0A
MOVWF TXREG
MOVWF PORTD
CALL DELAY

CLRF TXREG
BSF STATUS,RP0
CLRF TXSTA
BCF STATUS,RP0
CLRF RCSTA
GOTO ENDING
;-------------------------------------------------------------
; DELAY FUNCTIONS
;-------------------------------------------------------------
DELAY:
MOVLW 0X02
MOVWF 0X62
D3
MOVLW 0XFF
MOVWF 0X61
D2
MOVLW 0XFF
MOVWF 0X60
D1
DECFSZ 0X60,1
GOTO D1
DECFSZ 0X61,1
GOTO D2
DECFSZ 0X62,1
GOTO D3
RETURN
;-------------------------------------------------------------
ENDING:
END

#INCLUDE P16F877A.INC
LIST P=16F877A
ORG 0X00
GOTO START
ORG 0X20

;-----------------------------------------------------------
;RECIEVING SERIAL DATA
;-----------------------------------------------------------

START:
BSF STATUS,RP0
CLRF TRISB
MOVLW 0X00
MOVWF TRISD
BCF STATUS,RP0

MOVLW 0X90
MOVWF RCSTA

;LOOP:
;BTFSS PIR1,RCIF
;GOTO LOOP

BSF STATUS,RP0
MOVLW 0XFF
MOVWF SPBRG
MOVLW 0X24
MOVWF TXSTA
BCF STATUS,RP0
CLRF PORTB

OUT:
MOVF RCREG,0
MOVWF PORTD

MOVLW 0X0C
SUBWF RCREG,0
BTFSC STATUS,2
GOTO END_OF_RECEPTION
;CLRF TXREG
GOTO OUT

;-----------------------------------------------------------
;TRANSMITTING BACK THE DATA
;-----------------------------------------------------------

END_OF_RECEPTION:

MOVLW 0X0C
MOVWF PORTD

MOVLW 0X0A
MOVWF TXREG
MOVF TXREG,0
MOVWF PORTB
BSF STATUS,RP0
MOVLW 0XFF
MOVWF SPBRG
MOVLW 0X24
MOVWF TXSTA
BCF STATUS,RP0
BSF RCSTA,SPEN

MOVF TXREG,0
MOVWF PORTB

GOTO START


END












